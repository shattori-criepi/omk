## firmware/esp32/omk-node/src/Kconfig.projbuild
```kconfig
menu "OMK Mesh Configuration"

config OMK_RELAY_RESTART_NODE_ID
    string "Confirmed sensor-free relay Node ID permitted to restart on stuck Mesh send"
    default ""
    help
        Exact 12-character lowercase Node ID from the physical inventory.
        Empty disables the relay exception. A confirmed, running SEN66 also
        qualifies for the same child-only stuck-send restart.
        Root is always excluded. Early parent reselection does not need this.

config MESH_MAX_LAYER
    int "Mesh maximum layer"
    range 1 25
    default 6

config MESH_ROUTE_TABLE_SIZE
    int "Mesh route table size"
    range 1 300
    default 50

endmenu
```
