## firmware/esp32/omk-node/sdkconfig.defaults
```kconfig
CONFIG_BT_ENABLED=y
CONFIG_BT_BLUEDROID_ENABLED=y
CONFIG_BT_BLE_ENABLED=y
CONFIG_BTDM_CTRL_MODE_BLE_ONLY=y
CONFIG_BT_BLE_50_FEATURES_SUPPORTED=n
CONFIG_BT_BLE_42_FEATURES_SUPPORTED=y
CONFIG_BT_BLE_42_ADV_EN=y
CONFIG_COMPILER_DISABLE_GCC15_WARNINGS=y
CONFIG_ESP_PROTOCOMM_SUPPORT_SECURITY_VERSION_0=n
CONFIG_ESP_PROTOCOMM_SUPPORT_SECURITY_VERSION_1=y
CONFIG_ESP_PROTOCOMM_SUPPORT_SECURITY_VERSION_2=n
CONFIG_PARTITION_TABLE_CUSTOM=y
CONFIG_PARTITION_TABLE_CUSTOM_FILENAME="partitions.csv"

# Native Mesh: no internal IP forwarding or NAPT
CONFIG_LWIP_L2_TO_L3_COPY=y
CONFIG_LWIP_IP_FORWARD=n
CONFIG_LWIP_IPV4_NAPT=n
CONFIG_LWIP_TCP_MSS=1440
CONFIG_LWIP_TCP_OVERSIZE_MSS=y

# ESP-WIFI-MESH runtime limits; router/AP credentials are supplied at runtime.
CONFIG_MESH_MAX_LAYER=6
CONFIG_MESH_ROUTE_TABLE_SIZE=50
CONFIG_BT_BLUEDROID_PINNED_TO_CORE_0=n
CONFIG_BT_BLUEDROID_PINNED_TO_CORE_1=y
CONFIG_BT_BLUEDROID_PINNED_TO_CORE=1
CONFIG_BT_CTRL_PINNED_TO_CORE_0=n
CONFIG_BT_CTRL_PINNED_TO_CORE_1=y
CONFIG_BT_CTRL_PINNED_TO_CORE=1
CONFIG_BTDM_CTRL_PINNED_TO_CORE_0=n
CONFIG_BTDM_CTRL_PINNED_TO_CORE_1=y
CONFIG_BTDM_CTRL_PINNED_TO_CORE=1
CONFIG_BLUEDROID_PINNED_TO_CORE_0=n
CONFIG_BLUEDROID_PINNED_TO_CORE_1=y
CONFIG_BLUEDROID_PINNED_TO_CORE=1
CONFIG_ESP_COEX_SW_COEXIST_ENABLE=y
CONFIG_MQTT_OUTBOX_EXPIRED_TIMEOUT_MS=30000
```

## firmware/esp32/omk-node/src/Kconfig.projbuild
```kconfig
menu "OMK Mesh Configuration"

config MESH_MAX_LAYER
    int "Mesh maximum layer"
    range 1 25
    default 6

config MESH_ROUTE_TABLE_SIZE
    int "Mesh route table size"
    range 1 300
    default 50

config MESH_PARENT_RSSI_HIGH
    int "Mesh parent RSSI high threshold (dBm)"
    range -120 10
    default -78
    help
        High boundary used by ESP-WIFI-MESH when comparing a current parent
        and a candidate parent RSSI.

config MESH_PARENT_RSSI_MEDIUM
    int "Mesh parent RSSI medium threshold (dBm)"
    range -120 10
    default -82
    help
        Medium boundary used by ESP-WIFI-MESH when comparing a current parent
        and a candidate parent RSSI.

config MESH_PARENT_RSSI_LOW
    int "Mesh parent RSSI low threshold (dBm)"
    range -120 10
    default -85
    help
        ESP-IDF standard low boundary (-85 dBm), used to compare parent
        RSSI ranges and report a persistently weak current parent. Keep the
        standard high/medium/low values (-78/-82/-85) on AtomS3 Lite; a
        -84 to -85 dBm link can still carry measurements. This is not an
        application-enforced candidate cutoff.

endmenu
```
